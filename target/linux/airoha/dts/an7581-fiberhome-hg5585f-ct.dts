// SPDX-License-Identifier: (GPL-2.0-only OR BSD-2-Clause)
/dts-v1/;

#include "an7581-fiberhome-hg5585f-ct-common.dtsi"

/ {
	model = "FiberHome HG5585F CT";
	compatible = "fiberhome,hg5585f-ct", "airoha,an7581", "airoha,en7581";
};

/* Moto: USB 3.0 connector soldered onto the USB2 (silkscreen) port, hardware
 * fully populated. The stock USB 2.0-only lock on usb0 is removed, so usb0
 * uses the common USB 3.0 config (same as CU): both USB2 and USB3 PHYs,
 * SuperSpeed lane enabled. */
